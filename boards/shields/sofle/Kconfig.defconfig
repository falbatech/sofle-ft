## boards/shields/sofle/Kconfig.defconfig
```kconfig
if SHIELD_SOFLE_LEFT

config ZMK_KEYBOARD_NAME
    default "Sofle"

config ZMK_SPLIT
    default y

config ZMK_SPLIT_ROLE_CENTRAL
    default y

# OLED tylko na central
config ZMK_DISPLAY
    default y

config I2C
    default y

config SSD1306
    default y

config DISPLAY
    default y

# RGB
config ZMK_RGB_UNDERGLOW
    default y

# Encoder
config EC11
    default y

endif # SHIELD_SOFLE_LEFT


if SHIELD_SOFLE_RIGHT

config ZMK_SPLIT
    default y

# ❌ BRAK DISPLAY na prawej!

# RGB
config ZMK_RGB_UNDERGLOW
    default y

# Encoder
config EC11
    default y

endif # SHIELD_SOFLE_RIGHT
```

## boards/shields/sofle/Kconfig.shield
```kconfig
if SHIELD_SOFLE_LEFT || SHIELD_SOFLE_RIGHT

config ZMK_KEYBOARD_NAME
    default "Sofle"

config ZMK_SPLIT
    default y

endif

if SHIELD_SOFLE_LEFT

config ZMK_SPLIT_ROLE_CENTRAL
    default y

endif
```

## boards/shields/sofle0ft/Kconfig.defconfig
```kconfig
if SHIELD_SOFLE0FT_LEFT

config ZMK_KEYBOARD_NAME
    default "Sofle"

config ZMK_SPLIT
    default y

config ZMK_SPLIT_ROLE_CENTRAL
    default y

config ZMK_DISPLAY
    default y

config DISPLAY
    default y

config I2C
    default y

config SSD1306
    default y

config ZMK_RGB_UNDERGLOW
    default y

config EC11
    default y


endif # SHIELD_SOFLE0FT_LEFT


if SHIELD_SOFLE0FT_RIGHT

config ZMK_SPLIT
    default y

config ZMK_DISPLAY
    default y

config DISPLAY
    default y

config I2C
    default y

config SSD1306
    default y

config ZMK_RGB_UNDERGLOW
    default y

config EC11
    default y


endif # SHIELD_SOFLE0FT_RIGHT
```

## boards/shields/sofle0ft/Kconfig.shield
```kconfig
config SHIELD_SOFLE0FT_LEFT
    def_bool $(shields_list_contains,sofle0ft_left)

config SHIELD_SOFLE0FT_RIGHT
    def_bool $(shields_list_contains,sofle0ft_right)
```
